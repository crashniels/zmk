## app/boards/arm/k70_rgb/Kconfig.board
```kconfig
config BOARD_K70_RGB
    bool "k70_rgb"
    depends on SOC_SERIES_LPC11U3X
    select SOC_PART_NUMBER_LPC11U37FBD64
```

## app/boards/arm/k70_rgb/k70_rgb_defconfig
```kconfig
CONFIG_I2C=y
CONFIG_SYS_CLOCK_HW_CYCLES_PER_SEC=12000000
CONFIG_GPIO=y
CONFIG_SOC_SERIES_LPC11U3X=y
CONFIG_SOC_LPC11U37=y
CONFIG_MAIN_STACK_SIZE=512
CONFIG_ISR_STACK_SIZE=768
CONFIG_GPIO_LPC11U6X=y
CONFIG_CLOCK_CONTROL_LPC11U6X_ENABLE_SRAM1=y
CONFIG_CLOCK_CONTROL_LPC11U6X_ENABLE_USB_RAM=y
CONFIG_CLOCK_CONTROL_LPC11U6X_PLL_SRC_SYSOSC=n
# Uncomment to enable encoder
CONFIG_EC11=y
CONFIG_EC11_TRIGGER_GLOBAL_THREAD=y
```

## app/boards/arm/k95_rgb_platinum/Kconfig.board
```kconfig
config BOARD_K95_RGB_PLATINUM
    bool "k95_rgb_platinum"
    depends on SOC_SERIES_LPC11U6X
    select SOC_PART_NUMBER_LPC11U68JBD100
```

## app/boards/arm/k95_rgb_platinum/k95_rgb_platinum_defconfig
```kconfig
CONFIG_SOC_SERIES_LPC11U6X=y
CONFIG_SOC_LPC11U68=y
CONFIG_SYS_CLOCK_HW_CYCLES_PER_SEC=12000000
CONFIG_SERIAL=y
```

## app/boards/shields/k95_rgb_platinum/Kconfig.defconfig
```kconfig
if SHIELD_K95_RGB_PLATINUM

config ZMK_KEYBOARD_NAME
    default "Corsair K95 RGB Platinum / XT"

endif
```

## app/boards/shields/k95_rgb_platinum/Kconfig.shield
```kconfig
config SHIELD_K95_RGB_PLATINUM
    def_bool $(shields_list_contains,k95_rgb_platinum)
```
